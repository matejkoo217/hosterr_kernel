## drivers/ohos/Kconfig
```kconfig
menu "OpenHarmony / HarmonyOS userspace support"

config OHOS_DM_PARTNAME
	bool "Report device-mapper device names as PARTNAME in uevents"
	depends on BLK_DEV_DM=y
	default n
	help
	  OpenHarmony init creates /dev/block/by-name links only from the
	  PARTNAME uevent variable. Exposing the dm name lets logical
	  partitions mapped from the Android super partition be found
	  by name (system, vendor, chip_prod, sys_prod, ...).

config OHOS_BRINGUP_NOREBOOT
	bool "Allow refusing HarmonyOS init 'panic' reboots (hmos.noreboot=1)"
	default n

config OHOS_BRINGUP_PERMISSIVE
	bool "Allow forcing SELinux permissive (hmos.permissive=1)"
	depends on SECURITY_SELINUX_DEVELOP
	default n

config OHOS_DRM_AUTH_ALL
	bool "Let unprivileged HarmonyOS display HALs share /dev/dri/card0"
	depends on DRM
	default n
	help
	  HarmonyOS composer_host, allocator_host and render_service are
	  separate non-root processes that share the primary DRM node through
	  PRIME and hand DRM master between each other, without an Android
	  style authenticator.  This marks every DRM client as authenticated
	  and drops the DRM_MASTER requirement from the ioctl permission
	  check, so those processes can drive card0 without holding master.

	  This weakens DRM access control for all clients of the node; only
	  enable it while bringing up the HarmonyOS userspace.

config OHOS_FS_EMU
	bool "Emulate hmdfs/sharefs mounts with tmpfs + bind mounts"
	depends on TMPFS
	default n
	help
	  HarmonyOS storage_daemon needs the hmdfs and sharefs filesystems
	  in order to start a user.  Emulate their local (non-distributed)
	  views with a tmpfs plus bind mounts so that mount() succeeds and
	  the paths the daemon expects exist.

config OHOS_FSVERITY_STUB
	bool "Accept fs-verity / code-sign enable ioctls as no-ops"
	default n
	help
	  Lets HarmonyOS installd install HAPs with native libraries on a
	  kernel without fs-verity.  No integrity is enforced.

endmenu
```
